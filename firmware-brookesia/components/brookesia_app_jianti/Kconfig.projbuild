## firmware-brookesia/components/brookesia_app_jianti/Kconfig.projbuild
```kconfig
menu "JianTi App"

    config JIANTI_GATEWAY_URL
        string "本地网关 /solve 地址"
        default ""
        help
            简题 App 拍完题后把 JPEG POST 到这个地址，网关返回
            {"ok":true,"text":"..."}，App 取 text 显示在顶部正中。
            留空则 App 提示未配置网关，不上传。

    config JIANTI_WIFI_SSID
        string "WiFi SSID（可选兜底，留空不用）"
        default ""
        help
            凭据解析顺序：先复用在 Settings → WlanPage 里连上的 WiFi 配置，
            再读简题固件留下的 NVS（namespace "jt"，键 ssid/pass），
            最后才用这里的兜底值。都取不到时 App 提示去 Settings 连网。

    config JIANTI_WIFI_PASS
        string "WiFi 密码（可选兜底，留空不用）"
        default ""

    config JIANTI_JPEG_QUALITY
        int "JPEG 质量 (1-100)"
        range 1 100
        default 80

    config JIANTI_DEBUG_AUTOTEST
        bool "远程联调钩子（自动截屏 + 自动进 App + 自动拍题）"
        default n
        help
            仅调试构建开启。启动 20s 后截主屏，再进简题 App 截页，
            再触发一次拍题截结果，全部以 base64 JPEG 打到串口
            （===JT_SHOT_BEGIN/END=== 包裹）。量产固件必须关闭。

endmenu
```

## firmware-brookesia/sdkconfig.defaults.jianti
```kconfig
# 简题 App 本地联调默认值（不含任何 WiFi 凭据）
# 网关地址是局域网内的本机服务，非机密；凭据一律走运行时 NVS / Settings 配置。
# 公开归档时已把开发机实际内网地址替换为示例值，编译前请改成你自己的服务器地址。
CONFIG_JIANTI_GATEWAY_URL="http://192.168.1.100:8000/solve"
CONFIG_JIANTI_JPEG_QUALITY=80
# 批量交付构建：自动截屏 + 自动进 App + 自动拍题一律关闭（量产必须关闭）
# CONFIG_JIANTI_DEBUG_AUTOTEST is not set
```

## firmware/main/Kconfig.projbuild
```kconfig
menu "JianTi Camera Config"

    config JT_JPEG_QUALITY
        int "JPEG quality (1-100)"
        range 1 100
        default 80
        help
            Default quality for captured stills. Can be changed at runtime
            with the console command "q", e.g. "q 90".

    config JT_AUTOCAP_ENABLE
        bool "Auto capture once after boot"
        default y
        help
            Queue one capture a few seconds after boot, so the whole
            capture -> JPEG -> UART dump chain can be verified hands-free.

    config JT_AUTOCAP_DELAY_MS
        int "Auto capture delay (ms)"
        default 6000
        depends on JT_AUTOCAP_ENABLE

    config JT_WIFI_SSID
        string "WiFi SSID for v0.2 upload test (fill in sdkconfig locally)"
        default ""
        help
            Test AP name. Filled locally at build time; never commit a real
            password into the shared sources.

    config JT_WIFI_PASS
        string "WiFi password for v0.2 upload test (fill in sdkconfig locally)"
        default ""
        help
            Test AP password. Filled locally at build time only.

    config JT_GATEWAY_URL
        string "Gateway solve URL for v0.2 upload"
        default "http://192.168.1.100:8000/solve"
        help
            Full URL of the PC gateway /solve endpoint. Replace the IP with
            the LAN IP printed by gateway.py at startup.

endmenu
```
